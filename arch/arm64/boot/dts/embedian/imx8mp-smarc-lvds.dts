// SPDX-License-Identifier: (GPL-2.0+ OR MIT)
/*
 * Copyright 2021 Embedian, Inc.
 */

#include "imx8mp-smarc-common.dtsi"
#include "imx8mp-smarc-lvds.dtsi"

/ {
        model = "Embedian i.MX8MPlus SMARC-iMX8MP CPU Module LVDS";
};
