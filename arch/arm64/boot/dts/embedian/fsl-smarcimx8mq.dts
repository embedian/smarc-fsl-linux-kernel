/*
 * Copyright 2017 NXP
 * Copyright 2018 Embedian, Inc.
 *
 * This program is free software; you can redistribute it and/or
 * modify it under the terms of the GNU General Public License
 * as published by the Free Software Foundation; either version 2
 * of the License, or (at your option) any later version.
 *
 * This program is distributed in the hope that it will be useful,
 * but WITHOUT ANY WARRANTY; without even the implied warranty of
 * MERCHANTABILITY or FITNESS FOR A PARTICULAR PURPOSE.  See the
 * GNU General Public License for more details.
 */
/*
 *SMARC-iMX8M without Displays
 */

#include "fsl-smarcimx8mq-common.dtsi"

/ {
	model = "Embedian SMARC-iMX8M Computer on Module";
};

