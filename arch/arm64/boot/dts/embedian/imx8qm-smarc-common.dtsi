// SPDX-License-Identifier: GPL-2.0+
/*
 * Copyright 2018-2019 NXP
 * Copyright 2023 Embedian, Inc.
 *	Dong Aisheng <aisheng.dong@nxp.com>
 */

/dts-v1/;

#include <dt-bindings/usb/pd.h>
#include "../freescale/imx8qm.dtsi"

/ {
	model = "Embedian SMARC-iMX8QM CPU Module";
	compatible = "embedian,imx8qm-smarc", "fsl,imx8qm";

	chosen {
		stdout-path = &lpuart4;
	};

	memory@80000000 {
		device_type = "memory";
		reg = <0x00000000 0x80000000 0 0x40000000>;
	};

	reserved-memory {
		#address-cells = <2>;
		#size-cells = <2>;
		ranges;

		gpu_reserved: gpu_reserved@0x8800000000 {
			no-map;
			reg = <0x8 0x80000000 0 0x10000000>;
		};

		decoder_boot: decoder_boot@0x84000000 {
			no-map;
			reg = <0 0x84000000 0 0x2000000>;
		};
		encoder1_boot: encoder1_boot@0x86000000 {
			no-map;
			reg = <0 0x86000000 0 0x200000>;
		};
		encoder2_boot: encoder2_boot@0x86200000 {
			no-map;
			reg = <0 0x86200000 0 0x200000>;
		};
		decoder_rpc: decoder_rpc@0x92000000 {
			no-map;
			reg = <0 0x92000000 0 0x100000>;
		};
		dsp_reserved: dsp@92400000 {
			reg = <0 0x92400000 0 0x1000000>;
			no-map;
		};
		dsp_reserved_heap: dsp_reserved_heap {
			reg = <0 0x93400000 0 0xef0000>;
			no-map;
		};
		dsp_vdev0vring0: vdev0vring0@942f0000 {
			reg = <0 0x942f0000 0 0x8000>;
			no-map;
		};
		dsp_vdev0vring1: vdev0vring1@942f8000 {
			reg = <0 0x942f8000 0 0x8000>;
			no-map;
		};
		dsp_vdev0buffer: vdev0buffer@94300000 {
			compatible = "shared-dma-pool";
			reg = <0 0x94300000 0 0x100000>;
			no-map;
		};
		encoder1_rpc: encoder1_rpc@0x94400000 {
			no-map;
			reg = <0 0x94400000 0 0x700000>;
		};
		encoder2_rpc: encoder2_rpc@0x94b00000 {
			no-map;
			reg = <0 0x94b00000 0 0x700000>;
		};

		/* global autoconfigured region for contiguous allocations */
		linux,cma {
			compatible = "shared-dma-pool";
			reusable;
			size = <0 0x3c000000>;
			alloc-ranges = <0 0xc0000000 0 0x3c000000>;
			linux,cma-default;
		};

	};

	reg_usb_otg1_vbus: regulator-usbotg1-vbus {
		compatible = "regulator-fixed";
		regulator-name = "usb_otg1_vbus";
		regulator-min-microvolt = <5000000>;
		regulator-max-microvolt = <5000000>;
		gpio = <&lsio_gpio4 3 GPIO_ACTIVE_HIGH>;
		enable-active-high;
		regulator-always-on;
	};

	reg_usdhc2_vmmc: usdhc2-vmmc {
		compatible = "regulator-fixed";
		regulator-name = "SD1_SPWR";
		regulator-min-microvolt = <3000000>;
		regulator-max-microvolt = <3000000>;
		gpio = <&lsio_gpio4 7 GPIO_ACTIVE_HIGH>;
		off-on-delay-us = <4800>;
		enable-active-high;
	};

	reg_audio: fixedregulator@2 {
		compatible = "regulator-fixed";
		regulator-name = "sgtl5000_supply";
		regulator-min-microvolt = <3300000>;
		regulator-max-microvolt = <3300000>;
		regulator-always-on;
	};

	reg_1p8v: 1p8v {
		compatible = "regulator-fixed";
		regulator-name = "1P8V";
		regulator-min-microvolt = <1800000>;
		regulator-max-microvolt = <1800000>;
		regulator-always-on;
	};

	reg_1p2v: 1p2v {
		compatible = "regulator-fixed";
		regulator-name = "1P2V";
		regulator-min-microvolt = <1200000>;
		regulator-max-microvolt = <1200000>;
		regulator-always-on;
	};

	reg_1p5v: 1p5v {
		compatible = "regulator-fixed";
		regulator-name = "1P5V";
		regulator-min-microvolt = <1500000>;
		regulator-max-microvolt = <1500000>;
		regulator-always-on;
	};

	reg_2p8v: 2p8v {
		compatible = "regulator-fixed";
		regulator-name = "2P8V";
		regulator-min-microvolt = <2800000>;
		regulator-max-microvolt = <2800000>;
		regulator-always-on;
	};

	osc24m_clk: osc24m_clk {
		compatible = "fixed-clock";
		#clock-cells = <0>;
		clock-frequency = <24000000>;
	};

	sound-sgtl5000 {
		compatible = "simple-audio-card";
		simple-audio-card,name = "audio-sgtl5000";
		simple-audio-card,format = "i2s";
		simple-audio-card,bitclock-master = <&dailink_master>;
		simple-audio-card,frame-master = <&dailink_master>;
		simple-audio-card,cpu {
			sound-dai = <&sai1>;
		};

		dailink_master: simple-audio-card,codec {
			sound-dai = <&codec>;
		};
	};

	imx8qm_cm40: imx8qm_cm4@0 {
		compatible = "fsl,imx8qm-cm4";
		rsc-da = <0x90000000>;
		mbox-names = "tx", "rx", "rxdb";
		mboxes = <&lsio_mu5 0 1
			  &lsio_mu5 1 1
			  &lsio_mu5 3 1>;
		mub-partition = <3>;
		memory-region = <&vdevbuffer>, <&vdev0vring0>, <&vdev0vring1>,
				<&vdev1vring0>, <&vdev1vring1>, <&rsc_table0>;
		core-index = <0>;
		core-id = <IMX_SC_R_M4_0_PID0>;
		status = "okay";
		power-domains = <&pd IMX_SC_R_M4_0_PID0>,
				<&pd IMX_SC_R_M4_0_MU_1A>;
	};

	imx8qm_cm41: imx8x_cm4@1 {
		compatible = "fsl,imx8qm-cm4";
		rsc-da = <0x90100000>;
		mbox-names = "tx", "rx", "rxdb";
		mboxes = <&lsio_mu6 0 1
			  &lsio_mu6 1 1
			  &lsio_mu6 3 1>;
		mub-partition = <4>;
		memory-region = <&vdevbuffer>, <&vdev2vring0>, <&vdev2vring1>,
				<&vdev3vring0>, <&vdev3vring1>, <&rsc_table1>;
		core-index = <1>;
		core-id = <IMX_SC_R_M4_1_PID0>;
		status = "okay";
		power-domains = <&pd IMX_SC_R_M4_1_PID0>,
				<&pd IMX_SC_R_M4_1_MU_1A>;
	};

	reserved-memory {
		#address-cells = <2>;
		#size-cells = <2>;
		ranges;

		vdev0vring0: vdev0vring0@90000000 {
			reg = <0 0x90000000 0 0x8000>;
			no-map;
		};

		vdev0vring1: vdev0vring1@90008000 {
			reg = <0 0x90008000 0 0x8000>;
			no-map;
		};

		vdev1vring0: vdev1vring0@90010000 {
			reg = <0 0x90010000 0 0x8000>;
			no-map;
		};

		vdev1vring1: vdev1vring1@90018000 {
			reg = <0 0x90018000 0 0x8000>;
			no-map;
		};

		rsc_table0: rsc_table0@900ff000 {
			reg = <0 0x900ff000 0 0x1000>;
			no-map;
		};

		vdevbuffer: vdevbuffer {
                        compatible = "shared-dma-pool";
			reg = <0 0x90400000 0 0x100000>;
			no-map;
		};

		vdev2vring0: vdev0vring0@90100000 {
			reg = <0 0x90100000 0 0x8000>;
			no-map;
		};

		vdev2vring1: vdev0vring1@90108000 {
			reg = <0 0x90108000 0 0x8000>;
			no-map;
		};

		vdev3vring0: vdev1vring0@90110000 {
			reg = <0 0x90110000 0 0x8000>;
			no-map;
		};

		vdev3vring1: vdev1vring1@90118000 {
			reg = <0 0x90118000 0 0x8000>;
			no-map;
		};

		rsc_table1: rsc_table1@901ff000 {
			reg = <0 0x901ff000 0 0x1000>;
			no-map;
		};
	};
};

&cm40_intmux {
	status = "okay";
};

&cm41_intmux {
	status = "okay";
};

&dc0_pc {
	status = "okay";
};

&dc0_prg1 {
	status = "okay";
};

&dc0_prg2 {
	status = "okay";

};

&dc0_prg3 {
	status = "okay";
};

&dc0_prg4 {
	status = "okay";
};

&dc0_prg5 {
	status = "okay";
};

&dc0_prg6 {
	status = "okay";
};

&dc0_prg7 {
	status = "okay";
};

&dc0_prg8 {
	status = "okay";
};

&dc0_prg9 {
	status = "okay";
};

&dc0_dpr1_channel1 {
	status = "okay";
};

&dc0_dpr1_channel2 {
	status = "okay";
};

&dc0_dpr1_channel3 {
	status = "okay";
};

&dc0_dpr2_channel1 {
	status = "okay";
};

&dc0_dpr2_channel2 {
	status = "okay";
};

&dc0_dpr2_channel3 {
	status = "okay";
};

&dpu1 {
	status = "okay";
};

&dsp {
	compatible = "fsl,imx8qm-hifi4";
	memory-region = <&dsp_vdev0buffer>, <&dsp_vdev0vring0>,
			<&dsp_vdev0vring1>, <&dsp_reserved>;
	status = "disabled";
};

&acm {
	status = "okay";
};

&asrc0 {
	fsl,asrc-rate  = <48000>;
	status = "okay";
};

&asrc1 {
	assigned-clock-rates = <786432000>, <49152000>, <24576000>;
	fsl,asrc-rate = <48000>;
	status = "okay";
};

&amix {
	status = "okay";
};

&sai0 {
	#sound-dai-cells = <0>;
	assigned-clocks = <&clk IMX_SC_R_AUDIO_PLL_0 IMX_SC_PM_CLK_PLL>,
			<&clk IMX_SC_R_AUDIO_PLL_0 IMX_SC_PM_CLK_SLV_BUS>,
			<&clk IMX_SC_R_AUDIO_PLL_0 IMX_SC_PM_CLK_MST_BUS>,
			<&sai0_lpcg 0>;
	assigned-clock-rates = <786432000>, <49152000>, <12288000>, <49152000>;
	pinctrl-names = "default";
	pinctrl-0 = <&pinctrl_sai0>;
	status = "okay";
};

&sai1 {
	assigned-clocks = <&clk IMX_SC_R_AUDIO_PLL_0 IMX_SC_PM_CLK_PLL>,
			<&clk IMX_SC_R_AUDIO_PLL_0 IMX_SC_PM_CLK_SLV_BUS>,
			<&clk IMX_SC_R_AUDIO_PLL_0 IMX_SC_PM_CLK_MST_BUS>,
			<&sai1_lpcg 0>; /* FIXME: should be sai1, original code is 0 */
	assigned-clock-rates = <786432000>, <49152000>, <12288000>, <49152000>;
	pinctrl-names = "default";
	pinctrl-0 = <&pinctrl_sai1>;
	status = "okay";
};

&pwm_lvds0 {
	pinctrl-names = "default";
	pinctrl-0 = <&pinctrl_pwm_lvds0>;
	status = "disabled";
};

&dc1_pc {
	status = "okay";
};

&dc1_prg1 {
	status = "okay";
};

&dc1_prg2 {
	status = "okay";

};

&dc1_prg3 {
	status = "okay";
};

&dc1_prg4 {
	status = "okay";
};

&dc1_prg5 {
	status = "okay";
};

&dc1_prg6 {
	status = "okay";
};

&dc1_prg7 {
	status = "okay";
};

&dc1_prg8 {
	status = "okay";
};

&dc1_prg9 {
	status = "okay";
};

&dc1_dpr1_channel1 {
	status = "okay";
};

&dc1_dpr1_channel2 {
	status = "okay";
};

&dc1_dpr1_channel3 {
	status = "okay";
};

&dc1_dpr2_channel1 {
	status = "okay";
};

&dc1_dpr2_channel2 {
	status = "okay";
};

&dc1_dpr2_channel3 {
	status = "okay";
};

&dpu2 {
	status = "okay";
};

&pwm_lvds1 {
	pinctrl-names = "default";
	pinctrl-0 = <&pinctrl_pwm_lvds1>;
	status = "okay";
};

/* I2C_LCD */
&i2c0_lvds1 {
	#address-cells = <1>;
	#size-cells = <0>;
	pinctrl-names = "default";
	pinctrl-0 = <&pinctrl_lvds1_lpi2c0>;
	clock-frequency = <100000>;
	status = "okay";
};

&lpspi1 { /* SPI0 */
	#address-cells = <1>;
	#size-cells = <0>;
	fsl,spi-num-chipselects = <2>;
	pinctrl-names = "default";
	pinctrl-0 = <&pinctrl_lpspi1 &pinctrl_lpspi1_cs>;
	cs-gpios = <&lsio_gpio3 24 GPIO_ACTIVE_LOW>,
		<&lsio_gpio3 25 GPIO_ACTIVE_LOW>;
	status = "okay";

	spidev0: spi@0 {
		reg = <0>;
		compatible = "rohm,dh2228fv";
		spi-max-frequency = <30000000>;
	};
	
	spidev1: spi@1 {
		reg = <1>;
		compatible = "rohm,dh2228fv";
		spi-max-frequency = <30000000>;
	};
};

&lpspi3 { /* eSPI */
	#address-cells = <1>;
	#size-cells = <0>;
	fsl,spi-num-chipselects = <2>;
	pinctrl-names = "default";
	pinctrl-0 = <&pinctrl_lpspi3 &pinctrl_lpspi3_cs>;
        cs-gpios = <&lsio_gpio2 20 GPIO_ACTIVE_LOW>,
                   <&lsio_gpio2 21 GPIO_ACTIVE_LOW>;
        status = "okay";

        spidev2: spi@0 {
                reg = <0>;
                compatible = "rohm,dh2228fv";
                spi-max-frequency = <30000000>;
        };

        spidev3: spi@1 {
                reg = <1>;
                compatible = "rohm,dh2228fv";
                spi-max-frequency = <30000000>;
        };
};

&lpuart0 { /* SER0 */
	pinctrl-names = "default";
	pinctrl-0 = <&pinctrl_lpuart0>;
	status = "okay";
};

&lpuart1 { /* SER2 */
	pinctrl-names = "default";
	pinctrl-0 = <&pinctrl_lpuart1>;
	status = "okay";
};

&lpuart4 { /* SER3 */
        pinctrl-names = "default";
        pinctrl-0 = <&pinctrl_lpuart4>;
        status = "okay";
};

&lpuart3 { /* SER1 */
	pinctrl-names = "default";
	pinctrl-0 = <&pinctrl_lpuart3>;
	status = "okay";
};

&flexcan1 {
	pinctrl-names = "default";
	pinctrl-0 = <&pinctrl_flexcan1>;
	status = "okay";
};

&flexcan2 {
	pinctrl-names = "default";
	pinctrl-0 = <&pinctrl_flexcan2>;
	status = "okay";
};

&fec1 {
	pinctrl-names = "default";
	pinctrl-0 = <&pinctrl_fec1>;
	phy-mode = "rgmii-txid";
	phy-handle = <&ethphy0>;
	fsl,magic-packet;
	fsl,rgmii_rxc_dly;
	status = "okay";

	mdio {
		#address-cells = <1>;
		#size-cells = <0>;

		ethphy0: ethernet-phy@6 {
			compatible = "ethernet-phy-ieee802.3-c22";
			reg = <6>;
			at803x,eee-disabled;
			at803x,vddio-1p8v;
			vddio-supply = <&vddio0>;

			vddio0: vddio-regulator {
				regulator-min-microvolt = <1800000>;
				regulator-max-microvolt = <1800000>;
			};
		};

		ethphy1: ethernet-phy@7 {
			compatible = "ethernet-phy-ieee802.3-c22";
			reg = <7>;
			at803x,eee-disabled;
			at803x,vddio-1p8v;
			vddio-supply = <&vddio1>;

			vddio1: vddio-regulator {
				regulator-min-microvolt = <1800000>;
				regulator-max-microvolt = <1800000>;
			};
		};
	};
};

&fec2 {
	pinctrl-names = "default";
	pinctrl-0 = <&pinctrl_fec2>;
	phy-mode = "rgmii-txid";
	phy-handle = <&ethphy1>;
	fsl,magic-packet;
	fsl,rgmii_rxc_dly;
	status = "okay";
};

&flexspi0 {
	pinctrl-names = "default";
	pinctrl-0 = <&pinctrl_flexspi0>;
	nxp,fspi-dll-slvdly = <4>;
	status = "okay";
};

&pciea{
	pinctrl-names = "default";
	pinctrl-0 = <&pinctrl_pciea>;
	reset-gpio = <&lsio_gpio4 29 GPIO_ACTIVE_LOW>;
	ext_osc = <1>;
	status = "okay";
};

&pcieb{
	pinctrl-names = "default";
	pinctrl-0 = <&pinctrl_pcieb>;
	reset-gpio = <&lsio_gpio5 0 GPIO_ACTIVE_LOW>;
	ext_osc = <1>;
	status = "okay";
};

&sata {
	ext_osc = <1>;
	status = "okay";
};

&usbphy1 {
	status = "okay";
};

&usbotg1 {
	vbus-supply = <&reg_usb_otg1_vbus>;
	pinctrl-names = "default";
	pinctrl-0 = <&pinctrl_usbotg1>;
	dr_mode = "host";
	status = "okay";
};

&usb3_phy {
	status = "okay";
};

&usbotg3 {
	pinctrl-0 = <&pinctrl_usbotg3>;
	gpio = <&lsio_gpio4 4 GPIO_ACTIVE_HIGH>;
	status = "okay";
};

&usbotg3_cdns3 {
	dr_mode = "host";
	status = "okay";
};

&usdhc1 {
	assigned-clocks = <&clk IMX_SC_R_SDHC_0 IMX_SC_PM_CLK_PER>;
	assigned-clock-rates = <400000000>;
	pinctrl-names = "default", "state_100mhz", "state_200mhz";
	pinctrl-0 = <&pinctrl_usdhc1>;
	pinctrl-1 = <&pinctrl_usdhc1>;
	pinctrl-2 = <&pinctrl_usdhc1>;
	bus-width = <8>;
	no-sd;
	no-sdio;
	non-removable;
	status = "okay";
};

&usdhc2 {
	pinctrl-names = "default", "state_100mhz", "state_200mhz";
	pinctrl-0 = <&pinctrl_usdhc2>, <&pinctrl_usdhc2_gpio>;
	pinctrl-1 = <&pinctrl_usdhc2>, <&pinctrl_usdhc2_gpio>;
	pinctrl-2 = <&pinctrl_usdhc2>, <&pinctrl_usdhc2_gpio>;
	bus-width = <4>;
	vmmc-supply = <&reg_usdhc2_vmmc>;
	cd-gpios = <&lsio_gpio5 22 GPIO_ACTIVE_LOW>;
	wp-gpios = <&lsio_gpio5 21 GPIO_ACTIVE_HIGH>;
	status = "okay";
};

&i2c0 { /* I2C0_3V3 for RTC */
	#address-cells = <1>;
	#size-cells = <0>;
	clock-frequency = <100000>;
	pinctrl-names = "default";
	pinctrl-0 = <&pinctrl_lpi2c0>;
	status = "okay";

	s35390a: s35390a@30 {
		compatible = "sii,s35390a";
		reg = <0x30>;
	};
};

&i2c1 { /* I2C_PM */
	#address-cells = <1>;
	#size-cells = <0>;
	clock-frequency = <100000>;
	pinctrl-names = "default";
	pinctrl-0 = <&pinctrl_lpi2c1>;
	status = "okay";

	cape_eeprom0: cape_eeprom@57 {
		compatible = "at,24c256";
		reg = <0x57>;
	};

	codec: sgtl5000@a {
		compatible = "fsl,sgtl5000";
		#sound-dai-cells = <0>;
		reg = <0x0a>;
		clocks = <&mclkout0_lpcg 0>;
		clock-names = "mclk";
		VDDA-supply = <&reg_audio>;
		VDDIO-supply = <&reg_audio>;
		assigned-clocks = <&clk IMX_SC_R_AUDIO_PLL_0 IMX_SC_PM_CLK_PLL>,
				<&clk IMX_SC_R_AUDIO_PLL_0 IMX_SC_PM_CLK_SLV_BUS>,
				<&clk IMX_SC_R_AUDIO_PLL_0 IMX_SC_PM_CLK_MST_BUS>,
				<&mclkout0_lpcg 0>;
		assigned-clock-rates = <786432000>, <49152000>, <12288000>, <12288000>;
		status = "okay";
	};
};

&i2c3 { /* I2C_GP */
	#address-cells = <1>;
	#size-cells = <0>;
	clock-frequency = <100000>;
	pinctrl-names = "default";
	pinctrl-0 = <&pinctrl_lpi2c3>;
	status = "okay";

	baseboard_eeprom: baseboard_eeprom@50 {
		compatible = "at,24c256";
		reg = <0x50>;
	};
};

&isi_0 {
	status = "okay";

	cap_device {
		status = "okay";
	};

	m2m_device {
		status = "okay";
	};
};

&isi_1 {
	status = "okay";

	cap_device {
		status = "okay";
	};
};

&isi_2 {
	status = "okay";

	cap_device {
		status = "okay";
	};
};

&isi_3 {
	status = "okay";

	cap_device {
		status = "okay";
	};
};

&isi_4 {
	status = "okay";

	cap_device {
		status = "okay";
	};
};

&isi_5 {
	status = "okay";

	cap_device {
		status = "okay";
	};
};

&isi_6 {
	status = "okay";

	cap_device {
		status = "okay";
	};
};

&isi_7 {
	status = "okay";

	cap_device {
		status = "okay";
	};
};

&irqsteer_csi0 {
	status = "okay";
};

&irqsteer_csi1 {
	status = "okay";
};

&lsio_gpio0 {
	/* Enable wakeup-source from GPIO6-9*/

	pad-wakeup-num = <4>;	/* Total number of wakeup pads in gpio0 bank */

	/*
	 Each triple means:
	 gpio-key pin id
	 trigger type
	 gpio pin
	*/
	pad-wakeup = <IMX8QM_GPT0_CAPTURE SC_PAD_WAKEUP_LOW_LVL 15>, <IMX8QM_GPT1_COMPARE SC_PAD_WAKEUP_LOW_LVL 19>, <IMX8QM_GPT1_CAPTURE SC_PAD_WAKEUP_LOW_LVL 18>, <IMX8QM_GPT1_CLK SC_PAD_WAKEUP_LOW_LVL 17>;
};

&mipi_csi_0 {
	#address-cells = <1>;
	#size-cells = <0>;
	virtual-channel;
	status = "okay";

	/* Camera 0  MIPI CSI-2 (CSIS0) */
	port@0 {
		reg = <0>;
		mipi_csi0_ep: endpoint {
			remote-endpoint = <&ov5645_mipi_0_ep>;
			data-lanes = <1 2>;
			bus-type = <4>;
		};
	};
};

&mipi_csi_1 {
	#address-cells = <1>;
	#size-cells = <0>;
	virtual-channel;
	status = "okay";

	/* Camera 1  MIPI CSI-2 (CSIS1) */
	port@1 {
		reg = <1>;
		mipi_csi1_ep: endpoint {
			remote-endpoint = <&ov5645_mipi_1_ep>;
			data-lanes = <1 2>;
			bus-type = <4>;
		};
	};
};

&jpegdec {
       status = "okay";
};

&jpegenc {
       status = "okay";
};

&i2c_mipi_csi0 {
	#address-cells = <1>;
	#size-cells = <0>;
	pinctrl-names = "default";
	pinctrl-0 = <&pinctrl_i2c_mipi_csi0>;
	clock-frequency = <100000>;
	status = "okay";

	ov5645_mipi0: ov5645_mipi@3c {	/* Support Coral G840-00180-01 Camera Module */
		compatible = "ovti,ov5645";
		reg = <0x3c>;
		clocks = <&osc24m_clk>;
		clock-frequency = <24000000>;
		clock-names = "xclk";
		csi_id = <0>;
		vdddo-supply = <&reg_1p8v>;
		vdda-supply = <&reg_2p8v>;
		vddd-supply = <&reg_1p5v>;
		enable-gpios = <&lsio_gpio1 28 GPIO_ACTIVE_HIGH>;	/* GPIO0 */
		reset-gpios = <&lsio_gpio1 31 GPIO_ACTIVE_LOW>;		/* GPIO1 */
		ae_target = <52>;
		mipi_csi;

		status = "okay";
		port {
			ov5645_mipi_0_ep: endpoint {
				remote-endpoint = <&mipi_csi0_ep>;
				data-lanes = <1 2>;
				clocks-lanes = <0>;
			};
		};
	};
};

&i2c_mipi_csi1 {
	#address-cells = <1>;
	#size-cells = <0>;
	pinctrl-names = "default";
	pinctrl-0 = <&pinctrl_i2c_mipi_csi1>;
	clock-frequency = <100000>;
	status = "okay";

	ov5645_mipi1: ov5645_mipi@3c {
		compatible = "ovti,ov5645";
		reg = <0x3c>;
		clocks = <&osc24m_clk>;
		clock-names = "xclk";
		clock-frequency = <24000000>;
		csi_id = <1>;
		vdddo-supply = <&reg_1p8v>;
		vdda-supply = <&reg_2p8v>;
		vddd-supply = <&reg_1p5v>;
		enable-gpios = <&lsio_gpio1 27 GPIO_ACTIVE_HIGH>;	/* GPIO2 */
		reset-gpios = <&lsio_gpio1 30 GPIO_ACTIVE_LOW>;		/* GPIO3 */
		ae_target = <52>;
		mipi_csi;

		status = "okay";
		port {
			ov5645_mipi_1_ep: endpoint {
				remote-endpoint = <&mipi_csi1_ep>;
				data-lanes = <1 2>;
				clocks-lanes = <0>;
			};
		};
	};
};

&iomuxc {
	pinctrl-names = "default";
	pinctrl-0 = <&pinctrl_hog>;

	pinctrl_hog: hoggrp {
		fsl,pins = <
			IMX8QM_MIPI_CSI0_GPIO0_01_LSIO_GPIO1_IO28	0x06000040	/* GPIO0 */
			IMX8QM_MIPI_CSI1_GPIO0_01_LSIO_GPIO1_IO31	0x06000040	/* GPIO1 */
			IMX8QM_MIPI_CSI0_GPIO0_00_LSIO_GPIO1_IO27	0x06000040	/* GPIO2 */
			IMX8QM_MIPI_CSI1_GPIO0_00_LSIO_GPIO1_IO30	0x06000040	/* GPIO3 */
			IMX8QM_GPT0_CLK_LSIO_GPIO0_IO14			0x06000040	/* GPIO4 */
			IMX8QM_GPT0_COMPARE_LSIO_GPIO0_IO16		0x06000040	/* GPIO5 */
			IMX8QM_GPT0_CAPTURE_LSIO_GPIO0_IO15		0x06000040	/* GPIO6 */
			IMX8QM_GPT1_COMPARE_LSIO_GPIO0_IO19		0x06000040	/* GPIO7 */
			IMX8QM_GPT1_CAPTURE_LSIO_GPIO0_IO18		0x06000040	/* GPIO8 */
			IMX8QM_GPT1_CLK_LSIO_GPIO0_IO17			0x06000040	/* GPIO9 */
			IMX8QM_FLEXCAN2_TX_LSIO_GPIO4_IO02		0x06000040	/* GPIO10 */
			IMX8QM_FLEXCAN2_RX_LSIO_GPIO4_IO01		0x06000040	/* GPIO11 */
			IMX8QM_SCU_GPIO0_03_LSIO_GPIO0_IO31		0x06000020	/* LID# */
			IMX8QM_SCU_GPIO0_04_LSIO_GPIO1_IO00		0x06000020	/* SLEEP */
			IMX8QM_SCU_GPIO0_05_LSIO_GPIO1_IO01		0x06000020	/* CHARGING */
			IMX8QM_SCU_GPIO0_06_LSIO_GPIO1_IO02		0x06000020	/* CHARGER_PRSNT# */
			IMX8QM_SCU_GPIO0_07_LSIO_GPIO1_IO03		0x06000020	/* BATLOW# */
			IMX8QM_SCU_GPIO0_02_LSIO_GPIO0_IO30		0x06000020	/* CARRIER_STBY# */
			IMX8QM_SPDIF0_TX_LSIO_GPIO2_IO15		0x06000020	/* WDT_TIME_OUT# */
			IMX8QM_MCLK_OUT0_AUD_ACM_MCLK_OUT0		0x0600004c	/* MCLK_OUT0 */
			IMX8QM_QSPI1A_DATA0_LSIO_GPIO4_IO26		0x06000040	/* RGMII0_INT# */
			IMX8QM_QSPI1A_DATA1_LSIO_GPIO4_IO25		0x06000040	/* RGMII1_INT# */
		>;
	};

	pinctrl_cm41_i2c: cm41i2cgrp {
		fsl,pins = <
			IMX8QM_M41_I2C0_SDA_M41_I2C0_SDA			0x0600004c
			IMX8QM_M41_I2C0_SCL_M41_I2C0_SCL			0x0600004c
		>;
	};

	pinctrl_adc0: adc0grp {
		fsl,pins = <
			IMX8QM_ADC_IN0_DMA_ADC0_IN0				0xc0000060
		>;
	};

	pinctrl_esai0: esai0grp {
		fsl,pins = <
			IMX8QM_ESAI0_FSR_AUD_ESAI0_FSR				0xc6000040
			IMX8QM_ESAI0_FST_AUD_ESAI0_FST				0xc6000040
			IMX8QM_ESAI0_SCKR_AUD_ESAI0_SCKR			0xc6000040
			IMX8QM_ESAI0_SCKT_AUD_ESAI0_SCKT			0xc6000040
			IMX8QM_ESAI0_TX0_AUD_ESAI0_TX0				0xc6000040
			IMX8QM_ESAI0_TX1_AUD_ESAI0_TX1				0xc6000040
			IMX8QM_ESAI0_TX2_RX3_AUD_ESAI0_TX2_RX3			0xc6000040
			IMX8QM_ESAI0_TX3_RX2_AUD_ESAI0_TX3_RX2			0xc6000040
			IMX8QM_ESAI0_TX4_RX1_AUD_ESAI0_TX4_RX1			0xc6000040
			IMX8QM_ESAI0_TX5_RX0_AUD_ESAI0_TX5_RX0			0xc6000040
		>;
	};

	pinctrl_fec1: fec1grp {
		fsl,pins = <
			IMX8QM_COMP_CTL_GPIO_1V8_3V3_ENET_ENETB_PAD		0x000014a0
			IMX8QM_ENET0_MDC_CONN_ENET0_MDC				0x06000020
			IMX8QM_ENET0_MDIO_CONN_ENET0_MDIO			0x06000020
			IMX8QM_ENET0_RGMII_TX_CTL_CONN_ENET0_RGMII_TX_CTL	0x06000020
			IMX8QM_ENET0_RGMII_TXC_CONN_ENET0_RGMII_TXC		0x06000020
			IMX8QM_ENET0_RGMII_TXD0_CONN_ENET0_RGMII_TXD0		0x06000020
			IMX8QM_ENET0_RGMII_TXD1_CONN_ENET0_RGMII_TXD1		0x06000020
			IMX8QM_ENET0_RGMII_TXD2_CONN_ENET0_RGMII_TXD2		0x06000020
			IMX8QM_ENET0_RGMII_TXD3_CONN_ENET0_RGMII_TXD3		0x06000020
			IMX8QM_ENET0_RGMII_RXC_CONN_ENET0_RGMII_RXC		0x06000020
			IMX8QM_ENET0_RGMII_RX_CTL_CONN_ENET0_RGMII_RX_CTL	0x06000020
			IMX8QM_ENET0_RGMII_RXD0_CONN_ENET0_RGMII_RXD0		0x06000020
			IMX8QM_ENET0_RGMII_RXD1_CONN_ENET0_RGMII_RXD1		0x06000020
			IMX8QM_ENET0_RGMII_RXD2_CONN_ENET0_RGMII_RXD2		0x06000020
			IMX8QM_ENET0_RGMII_RXD3_CONN_ENET0_RGMII_RXD3		0x06000020
		>;
	};

	pinctrl_fec2: fec2grp {
		fsl,pins = <
			IMX8QM_COMP_CTL_GPIO_1V8_3V3_ENET_ENETA_PAD		0x000014a0
			IMX8QM_ENET1_RGMII_TX_CTL_CONN_ENET1_RGMII_TX_CTL	0x00000060
			IMX8QM_ENET1_RGMII_TXC_CONN_ENET1_RGMII_TXC		0x00000060
			IMX8QM_ENET1_RGMII_TXD0_CONN_ENET1_RGMII_TXD0		0x00000060
			IMX8QM_ENET1_RGMII_TXD1_CONN_ENET1_RGMII_TXD1		0x00000060
			IMX8QM_ENET1_RGMII_TXD2_CONN_ENET1_RGMII_TXD2		0x00000060
			IMX8QM_ENET1_RGMII_TXD3_CONN_ENET1_RGMII_TXD3		0x00000060
			IMX8QM_ENET1_RGMII_RXC_CONN_ENET1_RGMII_RXC		0x00000060
			IMX8QM_ENET1_RGMII_RX_CTL_CONN_ENET1_RGMII_RX_CTL	0x00000060
			IMX8QM_ENET1_RGMII_RXD0_CONN_ENET1_RGMII_RXD0		0x00000060
			IMX8QM_ENET1_RGMII_RXD1_CONN_ENET1_RGMII_RXD1		0x00000060
			IMX8QM_ENET1_RGMII_RXD2_CONN_ENET1_RGMII_RXD2		0x00000060
			IMX8QM_ENET1_RGMII_RXD3_CONN_ENET1_RGMII_RXD3		0x00000060
		>;
	};

	pinctrl_flexspi0: flexspi0grp {
		fsl,pins = <
			IMX8QM_QSPI0A_DATA0_LSIO_QSPI0A_DATA0     0x06000021
			IMX8QM_QSPI0A_DATA1_LSIO_QSPI0A_DATA1     0x06000021
			IMX8QM_QSPI0A_DATA2_LSIO_QSPI0A_DATA2     0x06000021
			IMX8QM_QSPI0A_DATA3_LSIO_QSPI0A_DATA3     0x06000021
			IMX8QM_QSPI0A_DQS_LSIO_QSPI0A_DQS         0x06000021
			IMX8QM_QSPI0A_SS0_B_LSIO_QSPI0A_SS0_B     0x06000021
			IMX8QM_QSPI0A_SCLK_LSIO_QSPI0A_SCLK       0x06000021
		>;
	};

	pinctrl_flexcan1: flexcan0grp {
		fsl,pins = <
			IMX8QM_FLEXCAN0_TX_DMA_FLEXCAN0_TX            0x21
			IMX8QM_FLEXCAN0_RX_DMA_FLEXCAN0_RX            0x21
		>;
	};

	pinctrl_flexcan2: flexcan1grp {
		fsl,pins = <
			IMX8QM_FLEXCAN1_TX_DMA_FLEXCAN1_TX            0x21
			IMX8QM_FLEXCAN1_RX_DMA_FLEXCAN1_RX            0x21
			>;
	};

	pinctrl_flexcan3: flexcan3grp {
		fsl,pins = <
			IMX8QM_FLEXCAN2_TX_DMA_FLEXCAN2_TX            0x21
			IMX8QM_FLEXCAN2_RX_DMA_FLEXCAN2_RX            0x21
			>;
	};

	pinctrl_isl29023: isl29023grp {
		fsl,pins = <
			IMX8QM_USDHC2_WP_LSIO_GPIO4_IO11		0x00000021
		>;
	};

	pinctrl_lpi2c0: lpi2c0grp {
		fsl,pins = <
			IMX8QM_HDMI_TX0_TS_SCL_DMA_I2C0_SCL	0x0600004c
			IMX8QM_HDMI_TX0_TS_SDA_DMA_I2C0_SDA	0x0600004c
		>;
	};

	pinctrl_lpi2c0_gpio: lpi2c0grp-gpio {
		fsl,pins = <
			IMX8QM_HDMI_TX0_TS_SCL_LSIO_GPIO2_IO02	0x0600004c
			IMX8QM_HDMI_TX0_TS_SDA_LSIO_GPIO2_IO03	0x0600004c
		>;
	};

	pinctrl_lpi2c1: lpi2c1grp {
		fsl,pins = <
			IMX8QM_USB_HSIC0_STROBE_DMA_I2C1_SCL	0x0600004c
			IMX8QM_USB_HSIC0_DATA_DMA_I2C1_SDA	0x0600004c
		>;
	};

	pinctrl_lpi2c1_gpio: lpi2c1grp-gpio {
		fsl,pins = <
			IMX8QM_USB_HSIC0_STROBE_LSIO_GPIO5_IO02	0xc600004c
			IMX8QM_USB_HSIC0_DATA_LSIO_GPIO5_IO01	0xc600004c
		>;
	};

	pinctrl_lpi2c3: lpi2c3grp {
		fsl,pins = <
			IMX8QM_SIM0_PD_DMA_I2C3_SCL		0x0600004c
			IMX8QM_SIM0_POWER_EN_DMA_I2C3_SDA	0x0600004c
		>;
	};

	pinctrl_lpi2c3_gpio: lpi2c3grp-gpio {
		fsl,pins = <
			IMX8QM_SIM0_PD_LSIO_GPIO0_IO03		0xc600004c
			IMX8QM_SIM0_POWER_EN_LSIO_GPIO0_IO04	0xc600004c
		>;
	};

	pinctrl_i2c0: i2c0grp {
		fsl,pins = <
			IMX8QM_HDMI_TX0_TS_SCL_DMA_I2C0_SCL	0x06000021
			IMX8QM_HDMI_TX0_TS_SDA_DMA_I2C0_SDA	0x06000021
		>;
	};

	pinctrl_i2c1: i2c1grp {
		fsl,pins = <
			IMX8QM_GPT0_CLK_DMA_I2C1_SCL 0x0600004c
			IMX8QM_GPT0_CAPTURE_DMA_I2C1_SDA 0x0600004c
		>;
	};

	pinctrl_i2c1_gpio: i2c1grp-gpio {
		fsl,pins = <
			IMX8QM_GPT0_CLK_LSIO_GPIO0_IO14		0xc600004c
			IMX8QM_GPT0_CAPTURE_LSIO_GPIO0_IO15	0xc600004c
		>;
	};

	pinctrl_lpspi1: lpspi1grp {
		fsl,pins = <
			IMX8QM_ADC_IN3_DMA_SPI1_SCK		0x06000040
			IMX8QM_ADC_IN4_DMA_SPI1_SDO		0x06000040
			IMX8QM_ADC_IN5_DMA_SPI1_SDI		0x06000040
		>;
	};

	pinctrl_lpspi1_cs: lpspi1cs {
		fsl,pins = <
			IMX8QM_ADC_IN6_LSIO_GPIO3_IO24		0x00000021
			IMX8QM_ADC_IN7_LSIO_GPIO3_IO25		0x00000021
		>;
	};

	pinctrl_lpspi2: lpspi2grp {
		fsl,pins = <
			IMX8QM_SPI2_SCK_DMA_SPI2_SCK		0x06000040
			IMX8QM_SPI2_SDO_DMA_SPI2_SDO		0x06000040
			IMX8QM_SPI2_SDI_DMA_SPI2_SDI		0x06000040
		>;
	};

	pinctrl_lpspi2_cs: lpspi2cs {
		fsl,pins = <
			IMX8QM_SPI2_CS0_LSIO_GPIO3_IO10		0x21
		>;
	};

	pinctrl_lpspi3: lpspi3grp {
		fsl,pins = <
			IMX8QM_SPI3_SCK_DMA_SPI3_SCK		0x06000040
			IMX8QM_SPI3_SDO_DMA_SPI3_SDO		0x06000040
			IMX8QM_SPI3_SDI_DMA_SPI3_SDI		0x06000040
		>;
	};

	pinctrl_lpspi3_cs: lpspics3grp {
		fsl,pins = <
			IMX8QM_SPI3_CS0_LSIO_GPIO2_IO20		0x00000021
			IMX8QM_SPI3_CS1_LSIO_GPIO2_IO21		0x00000021
		>;
	};

	pinctrl_sim0: sim0grp {
		fsl,pins = <
			IMX8QM_SIM0_CLK_DMA_SIM0_CLK		0xc0000021
			IMX8QM_SIM0_IO_DMA_SIM0_IO		0xc2000021
			IMX8QM_SIM0_PD_DMA_SIM0_PD		0xc0000021
			IMX8QM_SIM0_POWER_EN_DMA_SIM0_POWER_EN	0xc0000021
			IMX8QM_SIM0_RST_DMA_SIM0_RST		0xc0000021
		>;
	};

	pinctrl_lpuart0: lpuart0grp {
		fsl,pins = <
			IMX8QM_UART0_RX_DMA_UART0_RX				0x06000020
			IMX8QM_UART0_RTS_B_DMA_UART0_RTS_B			0x06000020
			IMX8QM_UART0_TX_DMA_UART0_TX				0x06000020
			IMX8QM_UART0_CTS_B_DMA_UART0_CTS_B			0x06000020
		>;
	};

	pinctrl_lpuart1: lpuart1grp {
		fsl,pins = <
			IMX8QM_UART1_RX_DMA_UART1_RX		0x06000020
			IMX8QM_UART1_TX_DMA_UART1_TX		0x06000020
			IMX8QM_UART1_CTS_B_DMA_UART1_CTS_B	0x06000020
			IMX8QM_UART1_RTS_B_DMA_UART1_RTS_B	0x06000020
		>;
	};

	pinctrl_lpuart2: lpuart2grp {
		fsl,pins = <
			IMX8QM_UART0_RTS_B_DMA_UART2_RX		0x06000020
			IMX8QM_UART0_CTS_B_DMA_UART2_TX		0x06000020
		>;
	};

	pinctrl_lpuart3: lpuart3grp {
		fsl,pins = <
			IMX8QM_M41_GPIO0_00_DMA_UART3_RX		0x06000020
			IMX8QM_M41_GPIO0_01_DMA_UART3_TX		0x06000020
		>;
	};

	pinctrl_lpuart4: lpuart4grp {
		fsl,pins = <
			IMX8QM_M40_GPIO0_00_DMA_UART4_RX		0x06000020
			IMX8QM_M40_GPIO0_01_DMA_UART4_TX		0x06000020
                >;
        };

	pinctrl_pwm_lvds0: pwmlvds0grp {
		fsl,pins = <
			IMX8QM_LVDS0_GPIO00_LVDS0_PWM0_OUT		0x00000020
		>;
	};

	pinctrl_pwm_lvds1: pwmlvds1grp {
		fsl,pins = <
			IMX8QM_LVDS1_GPIO00_LVDS1_PWM0_OUT		0x00000020
		>;
	};

	pinctrl_modem_reset: modemresetgrp {
		fsl,pins = <
			IMX8QM_QSPI1A_DQS_LSIO_GPIO4_IO22		0x06000021
		>;
	};

	pinctrl_modem_reset_sleep: modemreset_sleepgrp {
		fsl,pins = <
			IMX8QM_QSPI1A_DQS_LSIO_GPIO4_IO22		0x07800021
		>;
	};

	pinctrl_pciea: pcieagrp{
		fsl,pins = <
			IMX8QM_PCIE_CTRL0_WAKE_B_LSIO_GPIO4_IO28		0x04000021
			IMX8QM_PCIE_CTRL0_PERST_B_LSIO_GPIO4_IO29		0x06000021
		>;
	};

	pinctrl_pcieb: pciebgrp{
		fsl,pins = <
			IMX8QM_PCIE_CTRL1_WAKE_B_LSIO_GPIO4_IO31		0x04000021
			IMX8QM_PCIE_CTRL1_PERST_B_LSIO_GPIO5_IO00		0x06000021
		>;
	};

	pinctrl_sata: satagrp{
		fsl,pins = <
			IMX8QM_PCIE_CTRL1_CLKREQ_B_LSIO_GPIO4_IO30		0x06000021
		>;
	};

	pinctrl_sai0: sai0grp {
		fsl,pins = <
			IMX8QM_SPI0_CS1_AUD_SAI0_TXC              0x0600004c
			IMX8QM_SPI2_CS1_AUD_SAI0_TXFS             0x0600004c
			IMX8QM_SAI1_RXFS_AUD_SAI0_RXD             0x0600004c
			IMX8QM_SAI1_RXC_AUD_SAI0_TXD              0x0600006c
		>;
	};

	pinctrl_sai1: sai1grp {
		fsl,pins = <
			IMX8QM_SAI1_RXD_AUD_SAI1_RXD			0x06000040
			IMX8QM_SAI1_TXFS_AUD_SAI1_TXFS			0x06000040
			IMX8QM_SAI1_TXD_AUD_SAI1_TXD			0x06000060
			IMX8QM_SAI1_TXC_AUD_SAI1_TXC			0x06000040
		>;
	};

	pinctrl_typec: typecgrp {
		fsl,pins = <
			IMX8QM_QSPI1A_DATA0_LSIO_GPIO4_IO26		0x00000021
		>;
	};

	pinctrl_typec_mux: typecmuxgrp {
		fsl,pins = <
			IMX8QM_QSPI1A_SS0_B_LSIO_GPIO4_IO19		0x60
			IMX8QM_USB_SS3_TC3_LSIO_GPIO4_IO06		0x60
		>;
	};

	pinctrl_usbotg1: usbotg1 {
		fsl,pins = <
			IMX8QM_USB_SS3_TC0_LSIO_GPIO4_IO03		0x00000021
			IMX8QM_USB_SS3_TC2_LSIO_GPIO4_IO05		0x00000021
		>;
	};

	pinctrl_usbotg3: usbotg3 {
		fsl,pins = <
			IMX8QM_USB_SS3_TC1_LSIO_GPIO4_IO04		0x00000021
			IMX8QM_USB_SS3_TC3_LSIO_GPIO4_IO06		0x00000021
                >;
        };

	pinctrl_usdhc1: usdhc1grp {
		fsl,pins = <
			IMX8QM_EMMC0_CLK_CONN_EMMC0_CLK				0x06000041
			IMX8QM_EMMC0_CMD_CONN_EMMC0_CMD				0x00000021
			IMX8QM_EMMC0_DATA0_CONN_EMMC0_DATA0			0x00000021
			IMX8QM_EMMC0_DATA1_CONN_EMMC0_DATA1			0x00000021
			IMX8QM_EMMC0_DATA2_CONN_EMMC0_DATA2			0x00000021
			IMX8QM_EMMC0_DATA3_CONN_EMMC0_DATA3			0x00000021
			IMX8QM_EMMC0_DATA4_CONN_EMMC0_DATA4			0x00000021
			IMX8QM_EMMC0_DATA5_CONN_EMMC0_DATA5			0x00000021
			IMX8QM_EMMC0_DATA6_CONN_EMMC0_DATA6			0x00000021
			IMX8QM_EMMC0_DATA7_CONN_EMMC0_DATA7			0x00000021
			IMX8QM_EMMC0_STROBE_CONN_EMMC0_STROBE			0x00000041
		>;
	};

	pinctrl_usdhc2_gpio: usdhc2grpgpio {
		fsl,pins = <
			IMX8QM_USDHC1_DATA6_LSIO_GPIO5_IO21			0x00000021
			IMX8QM_USDHC1_DATA7_LSIO_GPIO5_IO22			0x00000021
			IMX8QM_USDHC1_RESET_B_LSIO_GPIO4_IO07			0x00000021
		>;
	};

	pinctrl_usdhc2: usdhc2grp {
		fsl,pins = <
			IMX8QM_USDHC1_CLK_CONN_USDHC1_CLK			0x06000041
			IMX8QM_USDHC1_CMD_CONN_USDHC1_CMD			0x00000021
			IMX8QM_USDHC1_DATA0_CONN_USDHC1_DATA0			0x00000021
			IMX8QM_USDHC1_DATA1_CONN_USDHC1_DATA1			0x00000021
			IMX8QM_USDHC1_DATA2_CONN_USDHC1_DATA2			0x00000021
			IMX8QM_USDHC1_DATA3_CONN_USDHC1_DATA3			0x00000021
			IMX8QM_USDHC1_VSELECT_CONN_USDHC1_VSELECT		0x00000021
		>;
	};

	pinctrl_i2c_mipi_csi0: i2c_mipi_csi0 {
		fsl,pins = <
			IMX8QM_MIPI_CSI0_I2C0_SCL_MIPI_CSI0_I2C0_SCL		0xc2000020
			IMX8QM_MIPI_CSI0_I2C0_SDA_MIPI_CSI0_I2C0_SDA		0xc2000020
		>;
	};

	pinctrl_i2c_mipi_csi1: i2c_mipi_csi1 {
		fsl,pins = <
			IMX8QM_MIPI_CSI1_I2C0_SCL_MIPI_CSI1_I2C0_SCL		0xc2000020
			IMX8QM_MIPI_CSI1_I2C0_SDA_MIPI_CSI1_I2C0_SDA		0xc2000020
		>;
	};

	pinctrl_mipi_csi0: mipi_csi0 {
		fsl,pins = <
			IMX8QM_MIPI_CSI0_MCLK_OUT_MIPI_CSI0_ACM_MCLK_OUT	0xC0000041
		>;
	};

	pinctrl_mipi_csi1: mipi_csi1 {
		fsl,pins = <
			IMX8QM_MIPI_CSI1_MCLK_OUT_MIPI_CSI1_ACM_MCLK_OUT	0xC0000041
		>;
	};

	pinctrl_lvds0_lpi2c1: lvds0lpi2c1grp {
		fsl,pins = <
			IMX8QM_LVDS0_I2C1_SCL_LVDS0_I2C1_SCL	0xc600004c
			IMX8QM_LVDS0_I2C1_SDA_LVDS0_I2C1_SDA	0xc600004c
		>;
	};

	pinctrl_lvds1_lpi2c1: lvds1lpi2c1grp {
		fsl,pins = <
			IMX8QM_LVDS1_I2C1_SCL_LVDS1_I2C1_SCL	0xc600004c
			IMX8QM_LVDS1_I2C1_SDA_LVDS1_I2C1_SDA	0xc600004c
		>;
	};

	pinctrl_lvds1_lpi2c0: lvds1lpi2c0grp {
		fsl,pins = <
			IMX8QM_LVDS1_I2C0_SCL_LVDS1_I2C0_SCL	0xc600004c
			IMX8QM_LVDS1_I2C1_SDA_LVDS1_I2C1_SDA	0xc600004c
                >;
        };

	pinctrl_wifi: wifigrp{
		fsl,pins = <
			IMX8QM_SCU_GPIO0_07_SCU_DSC_RTC_CLOCK_OUTPUT_32K	0x20
		>;
	};

	pinctrl_wifi_init: wifi_initgrp{
		fsl,pins = <
			/* reserve pin init/idle_state to support multiple wlan cards */
		>;
	};

	pinctrl_wlreg_on: wlregongrp{
		fsl,pins = <
			IMX8QM_LVDS1_I2C0_SDA_LSIO_GPIO1_IO13		0x06000000
		>;
	};

	pinctrl_wlreg_on_sleep: wlregon_sleepgrp{
		fsl,pins = <
			IMX8QM_LVDS1_I2C0_SDA_LSIO_GPIO1_IO13		0x07800000
		>;
	};

	pinctrl_mipi0_lpi2c0: mipi0_lpi2c0grp {
		fsl,pins = <
			IMX8QM_MIPI_DSI0_I2C0_SCL_MIPI_DSI0_I2C0_SCL	0xc6000020
			IMX8QM_MIPI_DSI0_I2C0_SDA_MIPI_DSI0_I2C0_SDA	0xc6000020
			IMX8QM_MIPI_DSI0_GPIO0_01_LSIO_GPIO1_IO19	0x00000040	/* eDP0 IRQ */
			IMX8QM_MIPI_DSI0_GPIO0_00_LSIO_GPIO1_IO18	0x00000020	/* eDP0 Enable */
		>;
	};

	pinctrl_mipi1_lpi2c0: mipi1_lpi2c0grp {
		fsl,pins = <
			IMX8QM_MIPI_DSI1_I2C0_SCL_MIPI_DSI1_I2C0_SCL	0xc6000020
			IMX8QM_MIPI_DSI1_I2C0_SDA_MIPI_DSI1_I2C0_SDA	0xc6000020
			IMX8QM_MIPI_DSI1_GPIO0_01_LSIO_GPIO1_IO23	0x00000020	/* eDP1 IRQ */
			IMX8QM_MIPI_DSI1_GPIO0_00_LSIO_GPIO1_IO22	0x00000020	/* eDP1 Enable */
		>;
	};

};

&thermal_zones {
	pmic-thermal0 {
		polling-delay-passive = <250>;
		polling-delay = <2000>;
		thermal-sensors = <&tsens IMX_SC_R_PMIC_0>;
		trips {
			pmic_alert0: trip0 {
				temperature = <110000>;
				hysteresis = <2000>;
				type = "passive";
			};
			pmic_crit0: trip1 {
				temperature = <125000>;
				hysteresis = <2000>;
				type = "critical";
			};
		};
		cooling-maps {
			map0 {
				trip = <&pmic_alert0>;
				cooling-device =
				<&A53_0 THERMAL_NO_LIMIT THERMAL_NO_LIMIT>,
				<&A53_1 THERMAL_NO_LIMIT THERMAL_NO_LIMIT>,
				<&A53_2 THERMAL_NO_LIMIT THERMAL_NO_LIMIT>,
				<&A53_3 THERMAL_NO_LIMIT THERMAL_NO_LIMIT>,
				<&A72_0 THERMAL_NO_LIMIT THERMAL_NO_LIMIT>,
				<&A72_1 THERMAL_NO_LIMIT THERMAL_NO_LIMIT>;
			};
		};
	};
};

&gpu_3d0{
	status = "okay";
};

&gpu_3d1{
	status = "okay";
};

&imx8_gpu_ss {
	memory-region=<&gpu_reserved>;
	status = "okay";
};

&mu_m0{
	interrupts = <GIC_SPI 472 IRQ_TYPE_LEVEL_HIGH>;
};

&mu1_m0{
	interrupts = <GIC_SPI 473 IRQ_TYPE_LEVEL_HIGH>;
};

&mu2_m0{
	interrupts = <GIC_SPI 474 IRQ_TYPE_LEVEL_HIGH>;
	status = "okay";
};

&vpu {
	compatible = "nxp,imx8qm-vpu";
	status = "okay";
};

&vpu_core0 {
	reg = <0x2d080000 0x10000>;
	memory-region = <&decoder_boot>, <&decoder_rpc>;
	status = "okay";
};

&vpu_core1 {
	reg = <0x2d090000 0x10000>;
	memory-region = <&encoder1_boot>, <&encoder1_rpc>;
	status = "okay";
};

&vpu_core2 {
	reg = <0x2d0a0000 0x10000>;
	memory-region = <&encoder2_boot>, <&encoder2_rpc>;
	status = "okay";
};
